## boards/shields/tsungyu_lily58/Kconfig.defconfig
```kconfig
if SHIELD_TSUNGYU_LILY58_LEFT

config ZMK_KEYBOARD_NAME
    default "tsungyu_lily58"

config ZMK_SPLIT_ROLE_CENTRAL
    default y

endif # SHIELD_TSUNGYU_LILY58_LEFT

if SHIELD_TSUNGYU_LILY58_LEFT || SHIELD_TSUNGYU_LILY58_RIGHT

config ZMK_SPLIT
    default y

endif # SHIELD_TSUNGYU_LILY58_LEFT || SHIELD_TSUNGYU_LILY58_RIGHT
```

## boards/shields/tsungyu_lily58/Kconfig.shield
```kconfig
config SHIELD_TSUNGYU_LILY58_LEFT
    def_bool $(shields_list_contains,tsungyu_lily58_left)

config SHIELD_TSUNGYU_LILY58_RIGHT
    def_bool $(shields_list_contains,tsungyu_lily58_right)
```
